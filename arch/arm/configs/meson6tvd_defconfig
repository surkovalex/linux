## arch/arm/configs/meson6tvd_defconfig
```kconfig
CONFIG_KERNEL_LZMA=y
CONFIG_SYSVIPC=y
CONFIG_NO_HZ=y
CONFIG_HIGH_RES_TIMERS=y
CONFIG_BSD_PROCESS_ACCT=y
CONFIG_IKCONFIG=y
CONFIG_IKCONFIG_PROC=y
CONFIG_BLK_DEV_INITRD=y
CONFIG_INITRAMFS_SOURCE="rootfs.cpio"
CONFIG_KALLSYMS_ALL=y
CONFIG_EMBEDDED=y
CONFIG_MODULES=y
CONFIG_MODULE_UNLOAD=y
CONFIG_ARCH_MESON6TVD=y
CONFIG_MESON_SUSPEND=y
CONFIG_MESON_LEGACY_REGISTER_API=y
CONFIG_ARM_ERRATA_751472=y
CONFIG_ARM_ERRATA_754322=y
CONFIG_ARM_ERRATA_764369=y
CONFIG_SMP=y
CONFIG_NR_CPUS=2
CONFIG_AEABI=y
CONFIG_HIGHMEM=y
# CONFIG_COMPACTION is not set
CONFIG_VFP=y
CONFIG_NEON=y
CONFIG_BINFMT_MISC=y
# CONFIG_AML_RTC is not set
CONFIG_AM_REMOTE=m
# CONFIG_MESON_NEW_INPUT_REMOTE is not set
# CONFIG_MESON_INPUT_KEYBOARD is not set
# CONFIG_AMLOGIC_BOARD_HAS_PMU is not set
CONFIG_AMLOGIC_USB
CONFIG_MMC_AML=y
# CONFIG_AMAUDIO is not set
CONFIG_VSYNC_RDMA=y
CONFIG_AM_VIDEO=y
# CONFIG_AM_LCD_OUTPUT is not set
CONFIG_AML_TV_LCD=y
CONFIG_FB_AM=y
CONFIG_FB_OSD1_DEFAULT_BITS_PER_PIXEL=32
CONFIG_FB_OSD1_DEFAULT_WIDTH=1920
CONFIG_FB_OSD1_DEFAULT_HEIGHT=1080
CONFIG_FB_OSD1_DEFAULT_WIDTH_VIRTUAL=1920
CONFIG_FB_OSD1_DEFAULT_HEIGHT_VIRTUAL=2160
# CONFIG_AMLOGIC_BACKLIGHT is not set
CONFIG_AM_GE2D=y
CONFIG_AM_LOGO=y
# CONFIG_AML_HDMI_TX is not set
CONFIG_POST_PROCESS_MANAGER=y
CONFIG_POST_PROCESS_MANAGER_PPSCALER=y
CONFIG_VIDEO_AMLOGIC_CAPTURE=y
CONFIG_AMLOGIC_CAPTURE_FRAME_ROTATE=y
CONFIG_AMLOGIC_VM_DISABLE_VIDEOLAYER=y
CONFIG_AMLOGIC_IONVIDEO=y
CONFIG_MALI400=y
CONFIG_MALI400_DEBUG=y
# CONFIG_AMLOGIC_ION is not set
# CONFIG_CRYPTO_AML_HW_CRYPRO is not set
# CONFIG_CRYPTO_DEVICE_DRIVER is not set
CONFIG_UEVENT_HELPER_PATH="/sbin/hotplug"
CONFIG_DEVTMPFS=y
CONFIG_DEVTMPFS_MOUNT=y
CONFIG_PROC_DEVICETREE=y
CONFIG_OF_SELFTEST=y
CONFIG_BLK_DEV_LOOP=y
CONFIG_SCSI=y
CONFIG_BLK_DEV_SD=y
CONFIG_BLK_DEV_SR=y
CONFIG_SCSI_MULTI_LUN=y
CONFIG_INPUT_POLLDEV=y
CONFIG_INPUT_EVDEV=y
CONFIG_INPUT_MISC=y
CONFIG_INPUT_UINPUT=y
CONFIG_DEVPTS_MULTIPLE_INSTANCES=y
CONFIG_I2C=y
CONFIG_I2C_CHARDEV=y
CONFIG_MEDIA_CAMERA_SUPPORT=y
CONFIG_V4L_PLATFORM_DRIVERS=y
CONFIG_ION=y
CONFIG_BACKLIGHT_LCD_SUPPORT=y
CONFIG_SOUND=y
CONFIG_SND=y
CONFIG_SND_SOC=y
CONFIG_SND_AML_M6_SOC=y
CONFIG_SND_AML_M_DUMMY_CODEC=y
# CONFIG_HID_GENERIC is not set
CONFIG_USB=y
CONFIG_USB_STORAGE=y
CONFIG_SWITCH=y
CONFIG_RTC_CLASS=y
CONFIG_UIO=y
CONFIG_UIO_PDRV=y
CONFIG_UIO_PDRV_GENIRQ=y
CONFIG_STAGING=y
CONFIG_ANDROID=y
CONFIG_ANDROID_BINDER_IPC=y
CONFIG_ASHMEM=y
CONFIG_ANDROID_LOGGER=y
CONFIG_ANDROID_LOW_MEMORY_KILLER=y
CONFIG_EXT2_FS=y
CONFIG_EXT3_FS=y
CONFIG_EXT3_FS_POSIX_ACL=y
CONFIG_EXT3_FS_SECURITY=y
CONFIG_EXT4_FS=y
CONFIG_EXT4_FS_POSIX_ACL=y
CONFIG_EXT4_FS_SECURITY=y
CONFIG_EXT4_DEBUG=y
CONFIG_QUOTA=y
CONFIG_QFMT_V2=y
CONFIG_FUSE_FS=y
CONFIG_ISO9660_FS=y
CONFIG_JOLIET=y
CONFIG_ZISOFS=y
CONFIG_UDF_FS=y
CONFIG_MSDOS_FS=y
CONFIG_VFAT_FS=y
CONFIG_TMPFS=y
CONFIG_CONFIGFS_FS=y
CONFIG_CRAMFS=y
CONFIG_NLS_CODEPAGE_437=y
CONFIG_NLS_ISO8859_1=y
CONFIG_PRINTK_TIME=y
CONFIG_MAGIC_SYSRQ=y
CONFIG_READABLE_ASM=y
CONFIG_DEBUG_FS=y
CONFIG_DEBUG_SECTION_MISMATCH=y
CONFIG_SCHEDSTATS=y
CONFIG_TIMER_STATS=y
CONFIG_DEBUG_INFO=y
CONFIG_RCU_CPU_STALL_TIMEOUT=60
# CONFIG_FTRACE is not set
CONFIG_CRC_T10DIF=y
CONFIG_CRC7=y
```

## drivers/amlogic/amaudio2/Kconfig
```kconfig
# AML AUDIO V2 control drivers

menu "Amlogic Audio Interface V2"

config	AMAUDIO2
	bool "Amlogic Audio Interface V2"
    	default n
    	depends on PLAT_MESON
	help
		"Amlogic Audio Interface V2, The interface different from amaudio"
	
endmenu	
```

## drivers/amlogic/crypto/Kconfig
```kconfig
menu "Amlogic Crypto Support"

config CRYPTO_AML_HW_CRYPRO
  bool "amlogic HW CRYPTO module"
	select CRYPTO_ALGAPI
	select CRYPTO_BLKCIPHER
	select CRYPTO_HASH
	default y
endmenu
```

## drivers/amlogic/trustzone/Kconfig
```kconfig
menu "Amlogic TrustZone Support"

config MESON_TRUSTZONE
	bool "Support Arm TrustZone"
	default n

endmenu
```

## drivers/amlogic/tvin/Kconfig
```kconfig
#
# Amlogic tvin devices configuration
#

menuconfig TVIN
	tristate "Amlogic TVIN support"
	default n

if TVIN

source "vdin/Kconfig"
source "tvafe/Kconfig"
source "hdmirx/Kconfig"
source "bt656/Kconfig"
source "csi/Kconfig"
source "viu/Kconfig"
source "it660x/Kconfig"
source "isp/Kconfig"
source "vdin_ctrl/Kconfig"
endif
```

## drivers/amlogic/wifi/Kconfig
```kconfig
menuconfig AM_WIFI
	bool "WiFi support"
	default n

if AM_WIFI
config AM_WIFI_SD_MMC
	bool "Amlogic SDIO Wi-Fi support"
	depends on AM_WIFI
	default n

config DHD_USE_STATIC_BUF
    bool "broadcom wifi static buff support"
    default n

config AM_WIFI_USB
	bool "Amlogic USB Wi-Fi Dongle Support"
	depends on AM_WIFI
	default n

source "broadcom/broadcm_40181/Kconfig"
source "broadcom/bcmdhd_1_141_xx/Kconfig"
source "broadcom/broadcm_4354/Kconfig"
source "realtek/rtl8xxx_EU/Kconfig"
source "realtek/rtl8xxx_EU_MP/Kconfig"
source "realtek/rtl8xxx_CU/Kconfig"
source "realtek/rtl8xxx_DU/Kconfig"
source "realtek/rtl8192EU/Kconfig"
source "realtek/rtl8189ES/Kconfig"
source "realtek/rtl8723BS/Kconfig"
source "realtek/rtl8723AU/Kconfig"
source "realtek/rtl8723BU/Kconfig"
source "realtek/rtl8811AU/Kconfig"
source "realtek/rtl8812AU/Kconfig"

endif # AM_WIFI
```
